/**************************************************************************
 This is an example for our Monochrome OLEDs based on SSD1306 drivers

 Pick one up today in the adafruit shop!
 ------> http://www.adafruit.com/category/63_98

 This example is for a 128x64 pixel display using I2C to communicate
 3 pins are required to interface (two I2C and one reset).

 Adafruit invests time and resources providing this open
 source code, please support Adafruit and open-source
 hardware by purchasing products from Adafruit!

 Written by Limor Fried/Ladyada for Adafruit Industries,
 with contributions from the open source community.
 BSD license, check license.txt for more information
 All text above, and the splash screen below must be
 included in any redistribution.
 **************************************************************************/

#include <Arduino.h>
#include <SPI.h>
#include <Wire.h>
#include <Adafruit_GFX.h>
#include <Adafruit_SSD1306.h>
#include <Adafruit_I2CDevice.h>
#include <OTA.h>
#include <WiFi.h>
#include <Secrets.h>

const char* ssid = SECRET_SSID;
const char* password = SECRET_PASS;

#define SCREEN_WIDTH 128 // OLED display width, in pixels
#define SCREEN_HEIGHT 64 // OLED display height, in pixels

#define polymathHeight 64
#define polymathWidth 64
const unsigned char polymath [] PROGMEM = {
	0x3f, 0x00, 0xfe, 0x01, 0xfc, 0x07, 0xf0, 0x0f, 0x7e, 0x01, 0xfc, 0x03, 0xf8, 0x0f, 0xe0, 0x1f, 
	0xfc, 0x03, 0xf8, 0x07, 0xf0, 0x1f, 0xc0, 0x3f, 0xf8, 0x07, 0xf0, 0x0f, 0xe0, 0x3f, 0x80, 0x7f, 
	0xf0, 0x0f, 0xe0, 0x1f, 0xc0, 0x7f, 0x00, 0xfe, 0xe0, 0x1f, 0xc0, 0x3f, 0x80, 0xfe, 0x01, 0xfc, 
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	0xf8, 0x07, 0xf0, 0x00, 0x00, 0x00, 0x00, 0x00, 0xf0, 0x0f, 0xe0, 0x00, 0x00, 0x00, 0x00, 0x00
};

// Declaration for an SSD1306 display connected to I2C (SDA, SCL pins)
// The pins for I2C are defined by the Wire-library. 
// On an arduino UNO:       A4(SDA), A5(SCL)
// On an arduino MEGA 2560: 20(SDA), 21(SCL)
// On an arduino LEONARDO:   2(SDA),  3(SCL), ...
#define OLED_RESET     4 // Reset pin # (or -1 if sharing Arduino reset pin)
#define SCREEN_ADDRESS 0x3C ///< See datasheet for Address; 0x3D for 128x64, 0x3C for 128x32
Adafruit_SSD1306 display(SCREEN_WIDTH, SCREEN_HEIGHT, &Wire, OLED_RESET);

void setup() {
#ifdef DEBUG
  Serial.begin(115900);
#endif

#ifdef DEBUG
  Serial.println("Booting");
#endif

  WiFi.mode(WIFI_STA);
  WiFi.begin(ssid, password);
  while (WiFi.waitForConnectResult() != WL_CONNECTED) {
#ifdef DEBUG
    Serial.println("Connection Failed! Rebooting...");
#endif
    delay(5000);
    ESP.restart();
  }

  OTABegin();

#ifdef DEBUG
  Serial.println("Ready");
  Serial.print("IP address: ");
  Serial.println(WiFi.localIP());
#endif

  // SSD1306_SWITCHCAPVCC = generate display voltage from 3.3V internally
  if (!display.begin(SSD1306_SWITCHCAPVCC, SCREEN_ADDRESS)) {
#ifdef DEBUG
    Serial.println(F("SSD1306 allocation failed"));
#endif
    for (;;)
      ; // Don't proceed, loop forever
  }

  // Clear the buffer
  display.clearDisplay();

  display.drawBitmap((display.width()  - polymathWidth ) / 2, (display.height() - polymathHeight) / 2, polymath, polymathWidth, polymathHeight, 1);
  
  display.display();
  OTABegin();
}

void loop() {
  OTAHandle();
}